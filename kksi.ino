#include <LiquidCrystal_I2C.h>
#include <Servo.h>
//#include <PCM.h>

LiquidCrystal_I2C lcd(0x27, 16, 2);

Servo servo;

//const unsigned char sample[] PROGMEM = {
//129, 130, 130, 131, 131, 131, 131, 131, 131, 131, 130, 129, 128,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 127, 
//};

unsigned long int avgValue;  //Store the average value of the sensor feedback
float b;
int buf[10],temp;

int val = 0; //variable nilai konversi analog ke  digital
int pos = 0; //variable sudut servo

int maximumRange = 100; //kebutuhan akan maksimal range
int minimumRange = 0; //kebutuhan akan minimal range
long duration, distance; //waktu untuk kalkulasi jarak

int frequency = 0;

#define echo 7 //ultra sonik
#define trig 6
//ultra sonik
#define SensorPin A0 
#define out3 5 // motor driver
//#define out4 4 // motor driver
#define sensorAir A1 
#define servoPin 8
#define S1 9 //sensor Warna
#define S2 10 //sensor Warna
#define S3 12 //sensor Warna
#define S4 13 //sensor Warna
#define out 3 //sensor Warna

void servo_on(){
  servo.write(45);  // Turn Servo ke kiri 45 degrees
   delay(1000);          
   servo.write(0);   // Turn Servo ke kiri to 0 degrees
   delay(1000);          
   servo.write(90);  // T urn Servo ke posisi center position (90 degrees)
   delay(1000);          
   servo.write(135); // Turn Servo Ke kanan 135 degrees
   delay(1000);          
   servo.write(180); // Turn Servo ke kanan 180 degrees
   delay(3000);
}

void servo_off(){          
   servo.write(0);   // Turn Servo ke kiri to 0 degrees
   delay(1000);
}

void setup() {
//  pin mode
  pinMode(servoPin,OUTPUT);
  pinMode(echo,INPUT);
  pinMode(trig,OUTPUT); 
  pinMode(5,OUTPUT);    
//  pinMode(out4,OUTPUT);
  
  servo.attach(servoPin);
  
  lcd.init();
  lcd.backlight();
    
  Serial.begin(9600);

  servo_off();

}

void motor_on(){
  digitalWrite(5,LOW);
  delay(5000);
  digitalWrite(5,HIGH);
  delay(1000);
}

void motor_off(){
  digitalWrite(5,HIGH);
  delay(500);
}

float ph_sensor(){
  for(int i=0;i<10;i++)       //Get 10 sample value from the sensor for smooth the value
  { 
    buf[i]=analogRead(SensorPin);
    delay(10);
  }
  for(int i=0;i<9;i++)        //sort the analog from small to large
  {
    for(int j=i+1;j<10;j++)
    {
      if(buf[i]>buf[j])
      {
        temp=buf[i];
        buf[i]=buf[j];
        buf[j]=temp;
      }
    }
  }
  avgValue=0;
  for(int i=2;i<8;i++)                      //take the average value of 6 center sample
    avgValue+=buf[i];
  float phValue=(float)avgValue*5.0/1024/6; //convert the analog into millivolt
  phValue=3.5*phValue;                      //convert the millivolt into pH value

  if(phValue < 5){
    motor_on();    
  }else if(phValue >= 8){
    motor_on();  
  }else{
    motor_off();
  }

  return phValue;
}

void fun_lcd(float ph){
  lcd.setCursor(0,0);
  lcd.print("Distance Water)");
  lcd.setCursor(0,1);
  lcd.print("PH Air ");
  lcd.print(ph);
}

void fun_ultra(){
  /* Berikut siklus trigPin atau echo pin yang digunakan
untuk menentukan jarak objek terdekat dengan memantulkan
gelombang suara dari itu. */
digitalWrite(trig, LOW);
delayMicroseconds(2);
digitalWrite(trig, HIGH);
delayMicroseconds(10);
digitalWrite(trig, LOW);
duration = pulseIn(echo, HIGH);

//perhitungan untuk dijadikan jarak
distance = duration/58.2;

/* Kirim angka negatif ke komputer dan Turn LED ON 
untuk menunjukkan "di luar jangkauan" */

//Serial.println(distance);
Serial.println(duration);

if (duration >= 1500)
{
  Serial.println("ok");
  servo_on();
}
else {

/*Kirim jarak ke komputer menggunakan Serial protokol, dan
menghidupkan LED OFF untuk menunjukkan memba */
Serial.println("tidak");
servo_off();
}
//waktu tunda 50mS
delay(50);
}

void loop() {
//  servo_on();
//  float ph = ph_sensor();

  fun_ultra();
//  motor_on();
//  fun_lcd(ph);
}
